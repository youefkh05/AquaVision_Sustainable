#include <Arduino.h>
#include "U8g2lib.h"

U8G2_SSD1306_128X64_NONAME_F_HW_I2C u8g2(U8G2_R0,SCL,SDA,U8X8_PIN_NONE);// [page temp_buffer, size = 128 bytes

// 'icon_battery', 128x20px
const unsigned char menu_icon_battery [] PROGMEM = {
0x00,0x00,0xc0,0x01,0xf0,0x07,0x08,0x08,0x08,0x09,0xc8,0x08,0xe8,0x0b,0x88,
 0x09,0x48,0x08,0x08,0x08,0xe8,0x0b,0xe8,0x0b,0x08,0x08,0xf0,0x07,0xc0,0x01,
 0x00,0x00,
};
// 'icon_temp', 128x20px
const unsigned char menu_icon_temp [] PROGMEM = {
0x00,0x00,0x18,0x00,0xa4,0x03,0x24,0x00,0x24,0x03,0x24,0xe0,0xbc,0xa3,0x3c,
0xe0,0x3c,0x03,0x7e,0x38,0x7e,0x44,0x7e,0x04,0x3c,0x04,0x18,0x44,0x00,0x38,
0x00,0x00,
};
// 'icon_waterdrop', 128x20px
const unsigned char menu_icon_waterdrop [] PROGMEM = {
0x00,0x00,0x0f,0x00,0x00,0x01,0x8c,0x03,0xc0,0x07,0xef,0x0f,0xa0,0x0f,0xac,
0x0f,0x60,0x0f,0xcf,0x24,0x80,0x73,0x0c,0xf8,0x00,0xe8,0x0f,0xd8,0x00,0x70,
0x0c,0x00,
};
// 'scrollbar_bckg', 128x20px
const unsigned char menu_scrollbar_bckg [] PROGMEM = {
 0x00,0x40,0x00,0x40,0x00,0x40,0x00,0x40,0x00,0x40,0x00,0x40,0x00,0x40,0x00,
 0x40,0x00,0x40,0x00,0x40,0x00,0x40,0x00,0x40,0x00,0x40,0x00,0x40,0x00,0x40,
 0x00,0x40,0x00,0x40,0x00,0x40,0x00,0x40,0x00,0x40,0x00,0x40,0x00,0x40,0x00,
 0x40,0x00,0x40,0x00,0x40,0x00,0x40,0x00,0x40,0x00,0x40,0x00,0x40,0x00,0x40,
 0x00,0x40,0x00,0x00,
};
// 'sel_outline', 128x20px
const unsigned char menu_sel_outline [] PROGMEM = {
 0xf8,0xff,0xff,0xff,0xff,0xff,0xff,0xff,0xff,0xff,0xff,0xff,0xff,0xff,0xff,
 0x03,0x04,0x00,0x00,0x00,0x00,0x00,0x00,0x00,0x00,0x00,0x00,0x00,0x00,0x00,
 0x00,0x04,0x02,0x00,0x00,0x00,0x00,0x00,0x00,0x00,0x00,0x00,0x00,0x00,0x00,
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 0xff,0xff,0xff,0xff,0x03,
};


// 'testoled', 128x64px (bitmap)
const unsigned char temp_measurement [] PROGMEM = {/*this image is xbm foramt image as the u8g2 accept this format only */
0x1F, 0x00, 0x00, 0x70, 0x7C, 0x00, 0x00, 0x7C, 0x3E, 0x00, 0x80, 0xCF, 
  0x07, 0x00, 0xE0, 0x7C, 0x1B, 0x00, 0x00, 0x60, 0x6C, 0x00, 0x00, 0x60, 
  0x36, 0x00, 0x00, 0xCC, 0x06, 0x00, 0xF0, 0x6C, 0x1B, 0x00, 0x00, 0x60, 
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  0x00, 0x00, 0x00, 0x00,
};


const unsigned char waterlevel_measurement [] PROGMEM = {/*this image is xbm foramt image as the u8g2 accept this format only */
0x1F, 0x00, 0x00, 0x80, 0x0F, 0x00, 0x00, 0x38, 0x3E, 0x00, 0x00, 0xC7, 
  0x07, 0x00, 0xF8, 0x7C, 0x1B, 0x00, 0x00, 0x80, 0x01, 0x00, 0x00, 0x30, 
  0x36, 0x00, 0x00, 0xC6, 0x00, 0x00, 0xC0, 0x6C, 0x1B, 0x00, 0x00, 0x80, 
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  0x00, 0x00, 0x00, 0x00,
};


#define UP_button 25
#define ENTER_button 26
#define DOWN_button 27

// Array of all bitmaps for convenience. (Total bytes used to store images in PROGMEM = 1680)
const unsigned char* menu_icons[3] = {
  menu_icon_waterdrop,
  menu_icon_battery,
  menu_icon_temp
};


const int n_items=3;
char items[n_items][20]= {
  {"Water level"},
  {"Battery level"},
  {"Temperature"} 
};

int previous; 
int selected=0; 
int next; 
int current_screen=0;
//temp measurements
int temp_progress = 0; //temp_progress bar
float temp  = 24 ;//variable to increase the temp_progress bar(in cm)
char temp_buffer[10];   // temp_buffer to hold the converted number
//water level measurements
int progress = 0; //progress bar
float var  =5.55 ;//variable to increase the progress bar(in cm)
char buffer[10];   // Buffer to hold the converted number

void setup() {
  pinMode(UP_button, INPUT_PULLUP);
  pinMode(ENTER_button, INPUT_PULLUP);
  pinMode(DOWN_button, INPUT_PULLUP);


  u8g2.setColorIndex(1);//white color
  u8g2.setBitmapMode(1);
  u8g2.begin();
}

void loop() {

if (current_screen == 0) {

if(digitalRead(UP_button)==LOW){
delay(200);
selected=selected-1;
if(selected < 0){selected=n_items-1;}
}

if(digitalRead(DOWN_button)==LOW){
delay(200);
selected=selected+1;
if(selected == n_items){selected=0;}
}

previous=selected-1;
if(previous < 0){previous=n_items-1;}
next=selected+1;
if(next >= n_items){next=0;}
}

if ((digitalRead(ENTER_button) == LOW)) { 
  delay(200); 
     if (current_screen == 0) {current_screen = 1;} 
     else if (current_screen == 1) {current_screen = 0;} 
}

  u8g2.firstPage();       
    do { 
       if (current_screen == 0) {
         u8g2.setFont(u8g_font_7x14);
         u8g2.drawStr(26, 15, items[0]);
         u8g2.drawXBMP(4, 2, 16, 16, menu_icons[0]);
         
         u8g2.setFont(u8g_font_7x14);
         u8g2.drawStr(26, 37, items[1]);
         u8g2.drawXBMP(4, 24, 16, 16, menu_icons[1]);
         
         u8g2.setFont(u8g_font_7x14);
         u8g2.drawStr(26, 59, items[2]);
         u8g2.drawXBMP(4, 46, 16, 16, menu_icons[2]);
         
        if(selected == 1){
        u8g2.drawXBMP(0,22, 128, 20, menu_sel_outline);}

        if(selected==2){
        u8g2.drawXBMP(0,44, 128, 20, menu_sel_outline);} 

        if(selected==0){
        u8g2.drawXBMP(0,0, 128, 20, menu_sel_outline);}
        u8g2.drawXBMP(120, 0, 8, 64, menu_scrollbar_bckg);
        
        // draw scrollbar handle
        u8g2.drawBox(125, 64/n_items * selected + 6, 3, 8);
       }
       else if(current_screen==1 && selected==2)
        {  u8g2.setFont(u8g2_font_helvB08_tr);//font
          dtostrf(temp, 6, 2, temp_buffer);  // Width = 6, Precision = 2 decimal places
       
        u8g2.setColorIndex(1); // white color
				 u8g2.drawXBMP(0, 0, 128, 64, temp_measurement);

				 u8g2.drawStr(25, 55, temp_buffer);

				    u8g2.setColorIndex(0);
					  u8g2.drawBox(2, 15, 124, 8);
					  u8g2.setColorIndex(1);
				  	u8g2.drawBox(2, 16, temp_progress, 6);
       }
       else if(current_screen==1 and selected==0){
        u8g2.setFont(u8g2_font_helvB08_tr);//font
       dtostrf(var, 6, 2, buffer);  // Width = 6, Precision = 2 decimal places
        u8g2.setColorIndex(1); // white color
				 u8g2.drawXBMP(0, 0, 128, 64, waterlevel_measurement);

				 u8g2.drawStr(25, 55, buffer);

				  u8g2.setColorIndex(0);
					u8g2.drawBox(2, 15, 124, 8);
					 u8g2.setColorIndex(1);
					u8g2.drawBox(2, 16, progress, 6);
       }
      

        } while (u8g2.nextPage());

        temp += 0.05;
    if(temp > 40)
    {
      temp = 24;
    }
    if ((temp_progress < 124) && (temp < 40)) {
     
        temp_progress= (temp * 124) / 40;
    } else {
        temp_progress = 0;
    }

    var +=0.05;
    if(var > 20)
    {
      var = 5.5;
    }
    if (progress < 124 && var<20) {
     
        progress=(var*124)/20;
    } else {
        progress = 0;
    }
}
